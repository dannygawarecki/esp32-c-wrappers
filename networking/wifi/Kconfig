## networking/wifi/Kconfig
```kconfig
menu "WiFi Configuration"

config WIFI_SSID
    string "WiFi SSID"
    default "your_ssid"
    help
        The SSID of the WiFi network to connect to.

config WIFI_PASSWORD
    string "WiFi Password"
    default "your_password"
    help
        The password of the WiFi network to connect to.

endmenu
```

## time-sync/sntp/Kconfig
```kconfig
menu "SNTP Time Sync Configuration"

config SNTP_TIMEZONE
    string "Timezone"
    default "UTC0"
    help
        Set the default timezone (e.g., "EST5EDT").

config SNTP_NTP_SERVER
    string "NTP Server"
    default "pool.ntp.org"
    help
        Set the NTP server to use for time synchronization.

config SNTP_RETRY_COUNT
    int "Retry Count"
    default 10
    help
        Set the number of retries for time synchronization.

endmenu
```
